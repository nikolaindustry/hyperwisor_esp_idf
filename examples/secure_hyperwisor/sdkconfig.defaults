## examples/secure_hyperwisor/sdkconfig.defaults
```kconfig
CONFIG_HYPERWISOR_ENABLE_OTA=n
CONFIG_HYPERWISOR_ENABLE_GPIO=n

## Point the device at your SECURED relay (change to your host):
CONFIG_HYPERWISOR_WS_HOST="your-secure-relay.onrender.com"
CONFIG_HYPERWISOR_WS_PORT=443

## Standard ESP-IDF flash + WiFi tweaks
CONFIG_ESPTOOLPY_FLASHSIZE_4MB=y
CONFIG_FREERTOS_HZ=1000
CONFIG_LWIP_SO_RCVBUF=y
```
